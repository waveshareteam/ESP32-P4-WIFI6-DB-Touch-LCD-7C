## examples/esp-idf/generic_gpio/main/Kconfig.projbuild
```kconfig
menu "Generic GPIO Example"

    choice EXAMPLE_GPIO_INITIAL_MODE_CHOICE
        prompt "Initial direction of the monitored GPIOs"
        default EXAMPLE_GPIO_INITIAL_MODE_INPUT
        help
            Direction the expansion header GPIOs are configured to when the example starts.

        config EXAMPLE_GPIO_INITIAL_MODE_INPUT
            bool "Input"
        config EXAMPLE_GPIO_INITIAL_MODE_OUTPUT
            bool "Output"
    endchoice

    # Value of the matching gpio_mode_t enumerator (GPIO_MODE_INPUT = 1, GPIO_MODE_OUTPUT = 2).
    config EXAMPLE_GPIO_INITIAL_MODE
        int
        default 1 if EXAMPLE_GPIO_INITIAL_MODE_INPUT
        default 2 if EXAMPLE_GPIO_INITIAL_MODE_OUTPUT

endmenu
```

## examples/esp-idf/lvgl_v8_demo/sdkconfig.defaults
```kconfig
CONFIG_IDF_TARGET="esp32p4"
CONFIG_SPIRAM=y
CONFIG_SPIRAM_MODE_HEX=y
CONFIG_SPIRAM_SPEED_200M=y
CONFIG_IDF_EXPERIMENTAL_FEATURES=y
CONFIG_LV_USE_PERF_MONITOR=y
CONFIG_LV_USE_LOG=y
CONFIG_LV_LOG_LEVEL_WARN=y
CONFIG_LV_LOG_PRINTF=y
CONFIG_LV_USE_DEMO_BENCHMARK=y
CONFIG_LV_MEM_SIZE_KILOBYTES=128
CONFIG_ESPTOOLPY_FLASHMODE_QIO=y
CONFIG_ESPTOOLPY_FLASHSIZE_32MB=y
CONFIG_PARTITION_TABLE_CUSTOM=y
CONFIG_PARTITION_TABLE_CUSTOM_FILENAME="partitions.csv"
CONFIG_BOOTLOADER_LOG_LEVEL_WARN=y
CONFIG_BOOTLOADER_COMPILER_OPTIMIZATION_SIZE=y
```

## examples/esp-idf/twai_sender/main/Kconfig.projbuild
```kconfig
menu "Example Configuration"

    config EXAMPLE_TWAI_TX_GPIO
        int "TWAI TX GPIO Num"
        default 22
        help
            GPIO number for TWAI TX to transceiver.

    config EXAMPLE_TWAI_RX_GPIO
        int "TWAI RX GPIO Num"
        default 21
        help
            GPIO number for TWAI RX from transceiver.

endmenu
```

## examples/esp-idf/uart_rs232/main/Kconfig.projbuild
```kconfig
menu "Echo Example Configuration"

    config EXAMPLE_UART_PORT_NUM
        int "UART port number"
        default 1
        help
            UART communication port number for the example.
            See UART documentation for available port numbers.

    config EXAMPLE_UART_BAUD_RATE
        int "UART communication speed"
        range 1200 115200
        default 115200
        help
            UART communication speed.

    config EXAMPLE_UART_RXD
        int "UART RXD pin number"
        default 29
        help
            GPIO number for UART RX pin. See UART documentation for more information
            about available pin numbers for UART.

    config EXAMPLE_UART_TXD
        int "UART TXD pin number"
        default 28
        help
            GPIO number for UART TX pin. See UART documentation for more information
            about available pin numbers for UART.

    config EXAMPLE_TASK_STACK_SIZE
        int "UART echo example task stack size"
        range 1024 16384
        default 3072
        help
            Defines stack size for UART echo example. Insufficient stack size can cause crash.

endmenu
```

## examples/esp-idf/uart_rs485/main/Kconfig.projbuild
```kconfig
menu "Echo RS485 Example Configuration"

    config ECHO_UART_PORT_NUM
        int "UART port number"
        default 1
        help
            UART communication port number for the example.
            See UART documentation for available port numbers.

    config ECHO_UART_BAUD_RATE
        int "UART communication speed"
        range 1200 115200
        default 115200
        help
            UART communication speed.

    config ECHO_RS485_RX_IO
        int "RS485 RXD pin number"
        default 27
        help
            GPIO number for RS485 RO pin. See UART documentation for more information
            about available pin numbers for UART.

    config ECHO_RS485_TX_IO
        int "RS485 TXD pin number"
        default 26
        help
            GPIO number for RS485 DI pin. See UART documentation for more information
            about available pin numbers for UART.

    config ECHO_RS485_DIRECTION_IO
        int "RS485 ~RE/DE pin number"
        default 34
        help
            GPIO number for the pin to connected to
            ~RE/DE pin of RS485 transceiver to switch direction.
            See UART documentation for more information about available pin
            numbers for UART.

    config ECHO_TASK_STACK_SIZE
        int "UART echo RS485 example task stack size"
        range 1024 16384
        default 3072
        help
            Defines stack size for UART echo RS485 example. Insufficient stack size can cause crash.

endmenu
```

## examples/esp_idf/06_uart_test/main/Kconfig.projbuild
```kconfig
menu "UART Loopback Example Configuration"

    config EXAMPLE_UART_PORT_NUM
        int "UART port number"
        default 1

    config EXAMPLE_UART_BAUD_RATE
        int "Baud rate"
        default 115200

    config EXAMPLE_UART_RS485_ENABLE
        bool "Enable RS485 half-duplex mode"
        default y
        help
            Enable UART half-duplex RS485 mode and let the UART RTS signal
            control the transceiver direction.

endmenu
```
